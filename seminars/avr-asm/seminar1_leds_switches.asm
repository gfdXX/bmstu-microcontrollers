/*
Example Applications 9-2 STK500 User Guide
===============================================
Connect PORTD to LEDS and PORTB to SWITCHES.
LEDs will operate differently depending on what switch is pressed.
Tip: Copy the code from this document into AVR Studio.
***** STK500 LEDS and SWITCH demonstration

Код модифицирован для использования отладочной платы EVBavr05
Индикация сетодиодами происходит в инверсном режиме:
светодиоды включаются низким уровнем на выводе порта PORTD
*/
;----- Подключить файл описания архитектуры
.include "m16def.inc"

;----- Определения переменных в регистрах
.def Temp 	=	r16 	; Временная переменная 1
.def Temp2	=	r19 	; Временная переменная 2
.def Temp3	=	r20 	; Временная переменная 3
.def Delay	=	r17 	; Параметр задержки 1
.def Delay2	=	r18 	; Параметр задержки 2

;----- Вектор прерывания по сбросу
RESET: 
	jmp	START

;----- Начало размещения кода
.org	0x100	;

START:
;----- Инициализация портов
	ser	Temp		//ser - Устанавливает все биты в регистре Temp в единицы	
	out	DDRD,temp 	; порт D на вывод. Устанавливает порт D как порт вывода
	clr	Temp			;llr(clear) - Очищает регистр Temp.
	out	DDRB,Temp		; порт B на ввод
	ser	Temp		;ser - Устанавливает все биты в регистре Temp в единицы.	
	out	PORTB,Temp	; включение "подтягивающих" резисторов на порту B
	mov Temp3,Temp		; mov(move) - Копирует значение Temp в Temp3.

	

;----- Проверка нажатия кнопок и индикация
LOOP:	;Начало основного цикла
		mov Temp2,Temp		;Копирует значение Temp в Temp2.
		eor Temp2,Temp3		; Использует операцию исключающего ИЛИ для получения разницы между Temp2 и Temp3 и сохраняет результат в Temp2.
		out	PORTD,Temp2 	; Обновить индикацию. Обновляет индикацию на светодиодах, устанавливая значения на порту D.
		sbis	PINB,0x00 	; Если нажата кнопка 0. ля проверки состояния каждой из кнопок на порту B (кнопки 0-6 и 7). Если кнопка нажата, выполняется соответствующая операция над Temp:
		inc	Temp 		; -> инкремент Temp,
					; иначе
		sbis	PINB,0x01 	; если нажата кнопка 1
		dec	Temp 		; -> декремент Temp,
					; иначе
		sbis	PINB,0x02 	; если нажата кнопка 2
		ror	Temp 		; -> сдвиг вправо 
					; иначе
		sbis	PINB,0x03 	; если нажата кнопка 3
		rol	Temp 		; -> сдвиг влево
					; иначе
		sbis	PINB,0x04 	; если нажата кнопка 4
		com	Temp 		; -> инверсия
					; иначе
		sbis	PINB,0x05 	; если нажата кнопка 5
		neg	Temp		; -> дополнение до 2
					; иначе
		sbis	PINB,0x06 	; если нажата кнопка 6
		swap	Temp 		; -> перестановка полубайтов

			; Число повторений внешнего цикла задержки

;---- Задержка, чтобы изменения состояния светодиодов были заметны
		ldi	Delay,0x00	; Число повторений внешнего цикла задержки.  устанавливают параметры для внешней и внутренней задержки внутри вложенного цикла и для строчки ниже 
		ldi	Delay2,0x00	; Число повторений внутреннего цикла задержки

		sbis	PINB,0x07 	; если нажата кнопка 7
		ldi	Delay2,0x01	;если нажата, то устанавливает внутреннюю задержку Delay2 в 1	

DLY:					;вложенный цикл с использованием регистров Delay, Delay2
		dec	Delay		; Эта команда уменьшает значение регистра Delay на 1 (decrement) при каждом выполнении цикла. Регистр Delay используется для управления внешней задержкой.
		brne	DLY		; Эта команда проверяет, равно ли значение регистра Delay нулю. Если Delay не равен нулю (при помощи "Branch if Not Equal"), то выполняется переход (branch) к метке DLY, что приводит к повторному выполнению цикла. Таким образом, этот цикл будет выполняться столько раз, сколько необходимо, чтобы значение Delay достигло нуля.
		dec	Delay2		;это в целом вложенный for, потому что он сначала 255 раз пройдет первый делей, зайдет во второй и опят начнет делать первый 255 и так пока в пером ноль, затем во втором ноль и выйдет.
		brne	DLY

;----  Возврат в начало бесконечного цикла
	rjmp	LOOP  			;в конце цикла происходит возврат к его началу, чтобы обновления на светодиодах были видны 

