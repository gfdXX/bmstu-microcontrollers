/* 	
 	Программа работы с таймером Т1 в режиме двухканальной ШИМ
	со взаимно инверсными режимами формирования выходного
	сигнала для управления яркостью свечения светодиодов

*/

.include "m16def.inc"		
.def temp 	= r16		; Вспомогательная переменная
.def Delay	= r17 		; Переменная задержки
.def Delay2	= r19 		; Переменная задержки 2
.def flag   = r18 		; Флаг направления
.def temp0 	= r20		; Вспомогательная переменная

.org 0x00					;Устанавливает начальный адрес программы на 0x00

RESET:
	jmp MAIN			;Вектор прерывания по сбросу, когда микроконтроллер сбрасывается, выполнение программы начинается с этой метки.

.org	0x0100				;Устанавливает начальный адрес программы на 0x0100.
MAIN:
	ldi 	temp,low(RAMEND)		; В этой строке загружается в регистр temp младшая часть адреса конца доступной оперативной памяти (RAMEND). Операция ldi (Load Immediate) используется для загрузки конкретного значения (в данном случае, младшей части адреса) в регистр temp.
	out 	SPL,temp			;Затем значение регистра temp, которое представляет младшую часть адреса RAMEND, загружается в регистр SPL (Stack Pointer Low). Это устанавливает указатель стека для нижней части доступной оперативной памяти.
	ldi 	temp,high(RAMEND)	;Инициализация стека; Также, как и верхние ток для верхней части
	out 	SPH,temp

	clr 	temp			;очистка регистра и выставление значение 0
	clr		temp0
	clr		flag
;Инициализация портов
	ldi 	temp,(1<<DDD4)|(1<<DDD5) ;создание битовой маски и логический сдвиг битов в лево, которая установит биты в еденицу.  Бит DDD4 и DDD5 отвечают за направление (вход или выход) соответствующих выводов порта D.
	out 	DDRD,temp		;4 и 5 разряды порта D на вывод 
	clr 	temp
	out 	DDRB,temp		;Все разряды порта B на ввод
	ser 	temp			; ser - все биты в единицы
	out 	PORTB,temp		;Включить подтягивающие резисторы

	clr 	temp			; Обнуление
	out 	OCR1AL,temp		; регистров
	out 	OCR1BL,temp		; сравнения
	out 	TCNT1L,temp		; таймера
	out 	TCNT1H,temp		; и счетчика

;=============== Настройка таймера ========================
;Канал А -прямая логика, канал В -инверсная;
;PWM Phase Correct, 8-bit
	ldi 	temp,(1<<COM1A1)|(1<<COM1B1)|(1<<COM1B0)|(1<<WGM10) ; Эти биты (COM1A1, COM1B1 и COM1B0) отвечают за управление режимами вывода для канала A (пин OC1A) и канала B (пин OC1B). Установка их в 1 и 0 соответственно означает, что канал A будет использовать "прямую" логику (неинверсный режим), а канал B будет использовать "инверсную" логику (режим инверсии).
	Этот бит (WGM10) отвечает за выбор режима работы таймера. Установка его в 1 указывает, что используется режим Phase Correct PWM, и для 8-битного разрешения.
	out 	TCCR1A,temp		
;Настройка предделителя и режима таймера
;CS12..10 = 001 : fck без деления
;|(1<<WGM12);(вариант для быстрой ШИМ) 
	ldi 	temp,(1<<CS10)		 Этот бит (CS10) устанавливает предделитель тактовой частоты равным 1. Это означает, что тактовая частота таймера будет равна основной частоте микроконтроллера (fck). Этот режим используется для получения максимальной частоты ШИМ.
	out 	TCCR1B,temp		; Загружает битовую маску для настройки предделителя и режима таймера в регистр TCCR1B. Это устанавливает предделитель равным 1 и выбирает указанный режим работы таймера T1.

;======== Основной цикл ===================================	
WAIT_0:					
;Перевод в устойчивые состояния выводов: LD4 светится, LD5 выключен 
	sbic	PINB,PINB0	; проверка нажатия кнопки SW0
	rjmp	WAIT_1			
		ldi 	temp,0xFF		;запись константы "0"в регистры сравнения
		out 	OCR1AL,temp		
		out 	OCR1BL,temp		

;*** Режим постоянного свечения LD5 ярче LD4
WAIT_1:
	sbic PINB,PINB1		;если не нажата кнопка SW1
	rjmp	WAIT_2			;- переход к следующей проверке,
			;иначе установка
		ldi 	temp, 0x08
		out 	OCR1AL,temp 	; коэффициента заполнения
		out 	OCR1BL,temp	; 8/256

;*** Режим постоянного свечения LD4 ярче LD5
WAIT_2:
	sbic	PINB,PINB2		;если не нажата кнопка SW2
	rjmp	WAIT_3			;- переход к следующей проверке,
			;иначе установка
		ldi 	temp, 0xF7
		out 	OCR1AL,temp 	; коэффициента заполнения
		out 	OCR1BL,temp	; 248/256

WAIT_3:
;***Перевод в устойчивые состояния выводов: LD4 выключен, LD5 светится 
	sbic PINB,PINB3		;если не нажата кнопка SW3
	rjmp WAIT_4			;- переход к следующей проверке, 

		clr 	temp			;иначе установка
		out 	OCR1AL,temp	; коэффициента заполнения
		out 	OCR1BL,temp	; 256/256

;====	Скачкообразное мерцание светодиодов в противофазе при нажатой кнопке SW4
WAIT_4:	
	sbic	PINB,PINB4		;проверка нажатия кнопки SW4:
	rjmp WAIT_0			;если не нажата - в начало 
					;основного цикла, иначе 
;----	Проверка направления
		tst	flag ; Эта инструкция проверяет значение переменной flag. Если flag не равно 0 (т.е., установлен флаг направления), то выполнение переходит к метке L0.
;если не 0 - уменьшение константы сравнения
		brne	L0		
; иначе увеличение константы
		subi	temp0,-25	;Здесь значение переменной temp0 увеличивается на 25. Это происходит, когда flag равен 0, что означает изменение направления.
; Если превышен максимум 
		cpi	temp0,0x00	;Эта инструкция сравнивает значение temp0 с 0x00 (нулем). Если temp0 равен 0, то выполнение переходит к метке L1.
		brne	L1
; - изменение направления
		com	flag		; флаг направления flag инвертируется (устанавливается в противоположное значение).
		rjmp	L1
L0:		; Уменьшение константы
		subi	temp0,25
; Если равно минимуму 
		cpi	temp0,0xFF	;Эта инструкция сравнивает значение temp0 с 0xFF. Если temp0 равен 0xFF, то выполнение переходит к метке L1.
		brne	L1
; - изменение направления
		com	flag		;флаг направления flag инвертируется (устанавливается в противоположное значение).
;----	Запись константы в регистры сравнения,
L1:
		out	OCR1AL,temp0	; запись значений в регстры
		out	OCR1BL,temp0		
;====	Окончание режима 4
; Настройка задержки
		ldi	Delay2,0x00	;запись в регистр 0
DLY:
			dec	Delay
			brne	DLY
			dec	Delay2
			brne	DLY
; и переход на следующую итерацию
	rjmp	WAIT_4

